/dts-v1/;

/ {

	fragment@0 {
		target = <0xffffffff>;

		__overlay__ {
			firmware-name = "fpga.bit.bin";

			clocking0 {
				#clock-cells = <0x00>;
				assigned-clock-rates = <0x7735940>;
				assigned-clocks = <0xffffffff 0x0f>;
				clock-output-names = "fabric_clk";
				clocks = <0xffffffff 0x0f>;
				compatible = "xlnx,fclk";
				phandle = <0x01>;
			};

			clocking1 {
				#clock-cells = <0x00>;
				assigned-clock-rates = <0xee6b280>;
				assigned-clocks = <0xffffffff 0x10>;
				clock-output-names = "fabric_clk";
				clocks = <0xffffffff 0x10>;
				compatible = "xlnx,fclk";
				phandle = <0x02>;
			};

			clocking2 {
				#clock-cells = <0x00>;
				assigned-clock-rates = <0x2faf080>;
				assigned-clocks = <0xffffffff 0x11>;
				clock-output-names = "fabric_clk";
				clocks = <0xffffffff 0x11>;
				compatible = "xlnx,fclk";
				phandle = <0x03>;
			};

			clocking3 {
				#clock-cells = <0x00>;
				assigned-clock-rates = <0xbebc200>;
				assigned-clocks = <0xffffffff 0x12>;
				clock-output-names = "fabric_clk";
				clocks = <0xffffffff 0x12>;
				compatible = "xlnx,fclk";
				phandle = <0x04>;
			};
		};
	};

	fragment@1 {
		target = <0xffffffff>;

		__overlay__ {

			afi0@f8008000 {
				compatible = "xlnx,afi-fpga";
				reg = <0xf8008000 0x1000>;
				xlnx,afi-width = <0x00>;
				phandle = <0x05>;
			};

			afi1@f8009000 {
				compatible = "xlnx,afi-fpga";
				reg = <0xf8009000 0x1000>;
				xlnx,afi-width = <0x00>;
				phandle = <0x06>;
			};

			xadc_wiz@83c00000 {
				clock-names = "s_axi_aclk";
				clocks = <0xffffffff 0x12>;
				compatible = "xlnx,xadc-wiz-3.3\0xlnx,axi-xadc-1.00.a";
				interrupt-names = "ip2intc_irpt";
				interrupt-parent = <0xffffffff>;
				interrupts = <0x00 0x1d 0x04>;
				reg = <0x83c00000 0x10000>;
				xlnx,alarm-limit-r0 = <0xb5ed>;
				xlnx,alarm-limit-r1 = <0x57e4>;
				xlnx,alarm-limit-r10 = <0x5555>;
				xlnx,alarm-limit-r11 = <0x5111>;
				xlnx,alarm-limit-r12 = <0x9999>;
				xlnx,alarm-limit-r13 = <0x91eb>;
				xlnx,alarm-limit-r14 = <0x6aaa>;
				xlnx,alarm-limit-r15 = <0x6666>;
				xlnx,alarm-limit-r2 = <0xa147>;
				xlnx,alarm-limit-r3 = <0xca33>;
				xlnx,alarm-limit-r4 = <0xa93a>;
				xlnx,alarm-limit-r5 = <0x52c6>;
				xlnx,alarm-limit-r6 = <0x9555>;
				xlnx,alarm-limit-r7 = <0xae4e>;
				xlnx,alarm-limit-r8 = <0x5999>;
				xlnx,alarm-limit-r9 = <0x5111>;
				xlnx,configuration-r0 = <0x00>;
				xlnx,configuration-r1 = <0x8100>;
				xlnx,configuration-r2 = <0x400>;
				xlnx,dclk-frequency = <0x64>;
				xlnx,external-mux = "none";
				xlnx,external-mux-channel = "VP_VN";
				xlnx,external-muxaddr-enable = <0x00>;
				xlnx,fifo-depth = <0x07>;
				xlnx,has-axi = <0x01>;
				xlnx,has-axi4stream = <0x00>;
				xlnx,has-busy = <0x01>;
				xlnx,has-channel = <0x01>;
				xlnx,has-convst = <0x00>;
				xlnx,has-convstclk = <0x00>;
				xlnx,has-dclk = <0x01>;
				xlnx,has-drp = <0x00>;
				xlnx,has-eoc = <0x01>;
				xlnx,has-eos = <0x01>;
				xlnx,has-external-mux = <0x00>;
				xlnx,has-jtagbusy = <0x00>;
				xlnx,has-jtaglocked = <0x00>;
				xlnx,has-jtagmodified = <0x00>;
				xlnx,has-ot-alarm = <0x01>;
				xlnx,has-reset = <0x00>;
				xlnx,has-temp-bus = <0x00>;
				xlnx,has-user-temp-alarm = <0x01>;
				xlnx,has-vbram-alarm = <0x00>;
				xlnx,has-vccaux-alarm = <0x01>;
				xlnx,has-vccddro-alarm = <0x01>;
				xlnx,has-vccint-alarm = <0x01>;
				xlnx,has-vccpaux-alarm = <0x01>;
				xlnx,has-vccpint-alarm = <0x01>;
				xlnx,has-vn = <0x01>;
				xlnx,has-vp = <0x01>;
				xlnx,include-intr = <0x01>;
				xlnx,sampling-rate = "961538.4615384615";
				xlnx,sequence-r0 = <0x800>;
				xlnx,sequence-r1 = <0x303>;
				xlnx,sequence-r2 = <0x00>;
				xlnx,sequence-r3 = <0x00>;
				xlnx,sequence-r4 = <0x00>;
				xlnx,sequence-r5 = <0x00>;
				xlnx,sequence-r6 = <0x00>;
				xlnx,sequence-r7 = <0x00>;
				xlnx,sim-file-name = "design";
				xlnx,sim-file-rel-path = "./";
				xlnx,sim-file-sel = "Default";
				xlnx,vaux0 = <0x01>;
				xlnx,vaux1 = <0x01>;
				xlnx,vaux10 = <0x00>;
				xlnx,vaux11 = <0x00>;
				xlnx,vaux12 = <0x00>;
				xlnx,vaux13 = <0x00>;
				xlnx,vaux14 = <0x00>;
				xlnx,vaux15 = <0x00>;
				xlnx,vaux2 = <0x00>;
				xlnx,vaux3 = <0x00>;
				xlnx,vaux4 = <0x00>;
				xlnx,vaux5 = <0x00>;
				xlnx,vaux6 = <0x00>;
				xlnx,vaux7 = <0x00>;
				xlnx,vaux8 = <0x01>;
				xlnx,vaux9 = <0x01>;
				phandle = <0x07>;
			};
		};
	};

	__symbols__ {
		clocking0 = "/fragment@0/__overlay__/clocking0";
		clocking1 = "/fragment@0/__overlay__/clocking1";
		clocking2 = "/fragment@0/__overlay__/clocking2";
		clocking3 = "/fragment@0/__overlay__/clocking3";
		afi0 = "/fragment@1/__overlay__/afi0@f8008000";
		afi1 = "/fragment@1/__overlay__/afi1@f8009000";
		xadc = "/fragment@1/__overlay__/xadc_wiz@83c00000";
	};

	__fixups__ {
		fpga_full = "/fragment@0:target:0";
		clkc = "/fragment@0/__overlay__/clocking0:assigned-clocks:0\0/fragment@0/__overlay__/clocking0:clocks:0\0/fragment@0/__overlay__/clocking1:assigned-clocks:0\0/fragment@0/__overlay__/clocking1:clocks:0\0/fragment@0/__overlay__/clocking2:assigned-clocks:0\0/fragment@0/__overlay__/clocking2:clocks:0\0/fragment@0/__overlay__/clocking3:assigned-clocks:0\0/fragment@0/__overlay__/clocking3:clocks:0\0/fragment@1/__overlay__/xadc_wiz@83c00000:clocks:0";
		amba = "/fragment@1:target:0";
		intc = "/fragment@1/__overlay__/xadc_wiz@83c00000:interrupt-parent:0";
	};
};
